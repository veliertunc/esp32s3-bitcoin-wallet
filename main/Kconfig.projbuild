## main/Kconfig.projbuild
```kconfig
menu "Bitcoin Wallet"

    choice BTC_NETWORK
        prompt "Bitcoin network"
        default BTC_NETWORK_TESTNET
        help
            Start on testnet (testnet4) to try the wallet with worthless coins.
            Switch to mainnet only after you have verified send/receive works.

        config BTC_NETWORK_TESTNET
            bool "Testnet4 (tb1..., coin type 1')"
        config BTC_NETWORK_MAINNET
            bool "Mainnet (bc1..., coin type 0')"
    endchoice

    config BTC_ESPLORA_URL
        string "Esplora REST API base URL"
        default "https://mempool.space/testnet4/api" if BTC_NETWORK_TESTNET
        default "https://mempool.space/api" if BTC_NETWORK_MAINNET
        help
            Any Esplora-compatible API (mempool.space, blockstream.info, or your own
            self-hosted mempool/electrs instance for better privacy).

    config BTC_GAP_LIMIT
        int "Address gap limit used when scanning"
        range 3 40
        default 10

    config WALLET_KDF_ITERATIONS
        int "PBKDF2-HMAC-SHA512 iterations for the SD-card wallet file"
        range 5000 400000
        default 50000
        help
            Higher = slower unlock but much harder to brute-force a stolen SD card.
            50000 takes roughly 5-8 s on the ESP32-S3.

    config WALLET_BIND_TO_DEVICE
        bool "Bind the encrypted wallet file to this device"
        default y
        help
            Mixes a random 32-byte secret stored in this board's NVS into the
            encryption key. A stolen SD card alone then cannot be brute-forced,
            but the file can only be opened on this board - your 24-word recovery
            phrase is the only way to restore elsewhere. Enable NVS/flash
            encryption for full protection of that secret.

    config WALLET_AUTOLOCK_SECONDS
        int "Auto-lock after inactivity (seconds, 0 = never)"
        default 180

    config WALLET_MAX_PIN_ATTEMPTS
        int "Wrong-password attempts before an increasing delay is enforced"
        default 3

    config BOARD_TOUCH_MIRROR_X
        bool "Mirror touch X axis"
        default n
    config BOARD_TOUCH_MIRROR_Y
        bool "Mirror touch Y axis"
        default n

endmenu
```

## sdkconfig.defaults
```kconfig
# ---- Target / flash -------------------------------------------------------
CONFIG_IDF_TARGET="esp32s3"
CONFIG_ESPTOOLPY_FLASHSIZE_16MB=y
CONFIG_ESPTOOLPY_FLASHMODE_QIO=y
CONFIG_PARTITION_TABLE_CUSTOM=y
CONFIG_PARTITION_TABLE_CUSTOM_FILENAME="partitions.csv"
CONFIG_ESP_DEFAULT_CPU_FREQ_MHZ_240=y
CONFIG_COMPILER_OPTIMIZATION_PERF=y

# ---- Octal PSRAM (ESP32-S3R8, 8 MB) ----------------------------------------
CONFIG_SPIRAM=y
CONFIG_SPIRAM_MODE_OCT=y
CONFIG_SPIRAM_SPEED_80M=y
CONFIG_SPIRAM_USE_MALLOC=y
CONFIG_SPIRAM_MALLOC_ALWAYSINTERNAL=4096
CONFIG_SPIRAM_MALLOC_RESERVE_INTERNAL=65536
CONFIG_SPIRAM_TRY_ALLOCATE_WIFI_LWIP=y

# ---- FreeRTOS / system ----------------------------------------------------
CONFIG_FREERTOS_HZ=1000
CONFIG_ESP_MAIN_TASK_STACK_SIZE=8192
CONFIG_ESP_TASK_WDT_TIMEOUT_S=30

# ---- Filesystems ----------------------------------------------------------
CONFIG_FATFS_LFN_HEAP=y
CONFIG_FATFS_MAX_LFN=255

# ---- TLS: use the Mozilla root bundle for HTTPS to the block explorer -----
CONFIG_MBEDTLS_CERTIFICATE_BUNDLE=y
CONFIG_MBEDTLS_CERTIFICATE_BUNDLE_DEFAULT_FULL=y
CONFIG_MBEDTLS_EXTERNAL_MEM_ALLOC=y
CONFIG_MBEDTLS_DYNAMIC_BUFFER=y
CONFIG_ESP_HTTP_CLIENT_ENABLE_HTTPS=y

# ---- App rollback for SD-card firmware updates ----------------------------
CONFIG_BOOTLOADER_APP_ROLLBACK_ENABLE=y

# ---- LVGL 9 ---------------------------------------------------------------
CONFIG_LV_COLOR_DEPTH_16=y
CONFIG_LV_USE_CLIB_MALLOC=y
CONFIG_LV_USE_CLIB_STRING=y
CONFIG_LV_USE_CLIB_SPRINTF=y
CONFIG_LV_DEF_REFR_PERIOD=20
CONFIG_LV_FONT_MONTSERRAT_12=y
CONFIG_LV_FONT_MONTSERRAT_14=y
CONFIG_LV_FONT_MONTSERRAT_16=y
CONFIG_LV_FONT_MONTSERRAT_20=y
CONFIG_LV_FONT_MONTSERRAT_28=y
CONFIG_LV_FONT_DEFAULT_MONTSERRAT_16=y
CONFIG_LV_USE_QRCODE=y
CONFIG_LV_USE_THEME_DEFAULT=y
CONFIG_LV_THEME_DEFAULT_DARK=y
CONFIG_LV_USE_LOG=y
CONFIG_LV_LOG_LEVEL_WARN=y
CONFIG_LV_USE_OBSERVER=y
```
